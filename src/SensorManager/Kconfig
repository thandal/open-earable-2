## src/SensorManager/Kconfig
```kconfig
menu "SensorManager"

#----------------------------------------------------------------------------#
menu "Thread priorities"

config SENSOR_PUB_THREAD_PRIO
	int "Priority for sensor publish thread"
	default 5
	help
	  This thread publishes polled sensor data to the zbus.

config SENSOR_WORK_QUEUE_PRIO
	int "Priority for sensor polling work queue"
	default 5
	help
	  This work queue thread periodically polls hardware sensors via I2C and enqueues data.

config SENSOR_GATT_NOTIFY_THREAD_PRIO
	int "Priority for sensor GATT notification thread"
	default 6
	help
	  This preemptible thread subscribes to sensor events from the zbus and pushes
	  them as BLE GATT notifications to connected clients.

config SENSOR_SD_THREAD_PRIO
    int "Priority for SD card sensor logging thread"
	default 3
	help
	  This preemptible thread subscribes to sensor events from the zbus and logs
	  them in bulk to the SD card.
endmenu # Thread priorities

#----------------------------------------------------------------------------#
menu "Stack sizes"

config SENSOR_PUB_STACK_SIZE
	int "Stack size for sensor publish thread"
	default 2048

config SENSOR_WORK_QUEUE_STACK_SIZE
	int "Stack size for sensor polling work queue thread"
	default 1024

config SENSOR_GATT_NOTIFY_STACK_SIZE
	int "Stack size for sensor GATT notification thread"
	default 2048

config SENSOR_SD_STACK_SIZE
    int "Stack size for SD card sensor logging thread"
	default 8192

endmenu # Stack sizes

#----------------------------------------------------------------------------#
menu "Zbus"

config SENSOR_SD_SUB_QUEUE_SIZE
	int "Queue size for SD card sensor subscriber"
	default 256

config SENSOR_GATT_SUB_QUEUE_SIZE
	int "Queue size for GATT notification sensor subscriber"
	default 256

endmenu # Zbus

#-----------------------------------------------------------------------------#
menu "Buffer management"

config SENSOR_CLOCK_ACCURACY
	int "Sensor clock accuracy (percentage)"
	default 5
	help
	  Typical worst-case clock accuracy percentage. This value is used to
	  account for drift between the sensor's hardware clock and the MCU's
	  system clock when calculating timestamps.

config SENSOR_LATENCY_MS
	int "Sensor reporting latency limit (ms)"
	default 40
	help
	  Maximum acceptable latency for sensor events in milliseconds.
	  This value determines the required hardware FIFO sizes for sensors
	  that buffer data before asserting an interrupt.

endmenu # Buffer management

endmenu # Modules
```
